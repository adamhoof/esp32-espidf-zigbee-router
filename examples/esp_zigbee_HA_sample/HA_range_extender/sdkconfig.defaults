## examples/esp_zigbee_HA_sample/HA_range_extender/sdkconfig.defaults
```kconfig
CONFIG_PARTITION_TABLE_CUSTOM=y
CONFIG_PARTITION_TABLE_CUSTOM_FILENAME="partitions.csv"
CONFIG_PARTITION_TABLE_FILENAME="partitions.csv"
CONFIG_PARTITION_TABLE_OFFSET=0x8000
CONFIG_PARTITION_TABLE_MD5=y

CONFIG_FREERTOS_UNICORE=y
#CONFIG_FREERTOS_USE_TICKLESS_IDLE=y
CONFIG_FREERTOS_HZ=1000

#CONFIG_PM_ENABLE=y
#CONFIG_PM_DFS_INIT_AUTO=n
#CONFIG_PM_MIN_FREQ_MHZ=10
#CONFIG_PM_MAX_FREQ_MHZ=96

CONFIG_MBEDTLS_HARDWARE_AES=n
CONFIG_MBEDTLS_HARDWARE_MPI=n
CONFIG_MBEDTLS_HARDWARE_SHA=n
CONFIG_MBEDTLS_CMAC_C=y
CONFIG_MBEDTLS_SSL_PROTO_DTLS=y
CONFIG_MBEDTLS_KEY_EXCHANGE_ECJPAKE=y
CONFIG_MBEDTLS_ECJPAKE_C=y

CONFIG_ZB_ENABLED=y
CONFIG_ZB_ZCZR=y

CONFIG_ESP_CONSOLE_UART_CUSTOM=y
CONFIG_ESP_CONSOLE_USB_SERIAL_JTAG=y

CONFIG_ESP_SYSTEM_USE_FRAME_POINTER=y
```
